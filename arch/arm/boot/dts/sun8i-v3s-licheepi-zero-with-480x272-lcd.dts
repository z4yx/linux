/*
 * Copyright (C) 2018 Icenowy Zheng <icenowy@aosc.io>
 *
 * SPDX-License-Identifier: (GPL-2.0+ OR X11)
 */

#include "sun8i-v3s-licheepi-zero-with-lcd.dtsi"

&panel {
	compatible = "qiaodian,qd43003c0-40", "simple-panel";
};
